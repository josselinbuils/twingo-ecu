## ecu/sdkconfig.defaults
```kconfig
# Defaults for generating a new "sdkconfig" file (project settings).
# https://docs.espressif.com/projects/esp-idf/en/latest/esp32/api-guides/build-system.html#custom-sdkconfig-defaults
#
# NOTE - if this file changes, to get new defaults, you must erase any existing
# "sdkconfig" file (this will undo manual settings from "idf.py menuconfig").

CONFIG_BT_ENABLED=y
CONFIG_BTDM_CTRL_MODE_BLE_ONLY=y
CONFIG_BTDM_CTRL_MODE_BR_EDR_ONLY=n
CONFIG_BTDM_CTRL_MODE_BTDM=n
CONFIG_BT_BLUEDROID_ENABLED=n
CONFIG_BT_NIMBLE_ENABLED=y

CONFIG_COMPILER_OPTIMIZATION_PERF=y # Compiler optimization level. Recommended level is "Performance" for good results. The "Performance"setting causes the compiled code to be larger and faster.

CONFIG_ESP_DEFAULT_CPU_FREQ_MHZ_240=y
CONFIG_ESP32S3_DATA_CACHE_LINE_64B=y
CONFIG_ESP32S3_DATA_CACHE_LINE_SIZE=64
CONFIG_ESPTOOLPY_FLASHFREQ_80M=y
CONFIG_ESPTOOLPY_FLASHMODE_QIO=y
CONFIG_ESPTOOLPY_FLASHSIZE_16MB=y
CONFIG_FREERTOS_HZ=1000
CONFIG_IDF_EXPERIMENTAL_FEATURES=y
CONFIG_IDF_TARGET="esp32s3"
CONFIG_SPIRAM_FETCH_INSTRUCTIONS=y
CONFIG_SPIRAM_MODE_OCT=y
CONFIG_SPIRAM_RODATA=y
CONFIG_SPIRAM_SPEED_80M=y
CONFIG_SPIRAM=y

CONFIG_ESP_CONSOLE_USB_SERIAL_JTAG=y

CONFIG_LOG_DEFAULT_LEVEL_DEBUG=y

CONFIG_LV_ATTRIBUTE_FAST_MEM_USE_IRAM=y # Fast LVGL memory. This option puts the most frequently used LVGL functions into IRAMforexecution speed up.
CONFIG_LV_BUILD_DEMO=n
CONFIG_LV_BUILD_EXAMPLES=n
CONFIG_LV_FONT_MONTSERRAT_48=y
CONFIG_LV_LOG_PRINTF=y
CONFIG_LV_MEM_CUSTOM=y
CONFIG_LV_MEM_SIZE_KILOBYTES=96
CONFIG_LV_MEMCPY_MEMSET_STD=y # Using esp-idf `memcpy` and `memset` instead LVGL's configuration. Native esp-idf implementation are a little (~1-3 FPS) faster.
CONFIG_LV_USE_LOG=y
CONFIG_LV_USE_PERF_MONITOR=n
```
